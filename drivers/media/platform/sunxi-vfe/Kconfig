## drivers/media/platform/sunxi-vfe/Kconfig
```kconfig
config CSI_VFE
	tristate "v4l2 driver for SUNXI"
	default m

config VIDEOBUF2_DMA_CONTIG
  tristate "VIDEOBUF2_DMA_CONTIG"
  default m
```

## drivers/net/wireless/rtl8822be/Kconfig
```kconfig
config RTL8822BE
	tristate "Realtek 8822B PCIE WiFi"
	depends on PCIE_SUNXI
	---help---
	  Help message of RTL8822BE
```
